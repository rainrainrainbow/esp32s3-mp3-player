## sdkconfig.defaults
```kconfig
# ESP32-S3 MP3 Player sdkconfig defaults
# IDF v6.1 - TinyUSB CDC + MSC, no hardware UART
CONFIG_IDF_TARGET="esp32s3"
CONFIG_ESP32S3_DEFAULT_CPU_FREQ_MHZ_240=y
CONFIG_ESP32S3_DEFAULT_CPU_FREQ_MHZ=240
CONFIG_ESPTOOLPY_FLASHMODE_QIO=y
CONFIG_ESPTOOLPY_FLASHFREQ_80M=y
CONFIG_ESPTOOLPY_FLASHSIZE_16MB=y

# FATFS with wear levelling
CONFIG_FATFS_VOLUME_COUNT=1
CONFIG_WL_SECTOR_SIZE=4096

# SPI Flash
CONFIG_SPI_FLASH_WRITING_DANGEROUS_REGIONS_ABORTS=y

# FreeRTOS
CONFIG_FREERTOS_HZ=1000

# Log level
CONFIG_LOG_DEFAULT_LEVEL=3

# PSRAM
CONFIG_SPIRAM=y
CONFIG_SPIRAM_MODE_OCT=y
CONFIG_SPIRAM_TYPE_AUTO=y
CONFIG_SPIRAM_USE_CAP_ALLOC=y
CONFIG_SPIRAM_MALLOC_ALWAYSINTERNAL=4096

# Disable hardware UART console - using TinyUSB CDC instead
CONFIG_ESP_CONSOLE_USB_SERIAL_JTAG=n
CONFIG_ESP_CONSOLE_UART_DEFAULT=n
CONFIG_ESP_CONSOLE_SECONDARY_NONE=y
CONFIG_ESP_CONSOLE_NONE=y

# TinyUSB
CONFIG_TINYUSB_ENABLED=y
CONFIG_TINYUSB_MSC_ENABLED=y
CONFIG_TINYUSB_MSC_BUFSIZE=4096
CONFIG_TINYUSB_CDC_ENABLED=y
CONFIG_TINYUSB_CDC_EP_BUFSIZE=64
CONFIG_TINYUSB_CDC_RX_BUFSIZE=64
CONFIG_TINYUSB_CDC_TX_BUFSIZE=64

# LVGL v8.3
CONFIG_LV_COLOR_DEPTH_16=y
CONFIG_LV_COLOR_16_SWAP=y
CONFIG_LV_MEM_CUSTOM=y
CONFIG_LV_MEMCPY_MEMSET_STD=y
CONFIG_LV_TICK_CUSTOM=y
CONFIG_LV_TICK_CUSTOM_SYS_TIME_EXPR="(esp_timer_get_time() / 1000)"
CONFIG_LV_USE_FS_POSIX=y
CONFIG_LV_FS_POSIX_LETTER=65
CONFIG_LV_FONT_MONTSERRAT_48=y
CONFIG_LV_LABEL_TEXT_SELECTION=y
```
